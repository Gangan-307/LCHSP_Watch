## lvgl_v8_example/project/build_sf32lb52-lchspi-ulp_hcpu/Kconfig
```kconfig
source "$SIFLI_SDK/Kconfig.v2"
source "$SIFLI_SDK/customer/boards/Kconfig.v2"
source "D:/iotproject/LCHSP/OpenSiFli/sifli-sdk/customer/boards/sf32lb52-lchspi-ulp/hcpu/Kconfig.board"
source "D:/iotproject/lcHspEc800m/lcHsp/lvgl/lvgl_v8_example/project/Kconfig.proj"
```

## pan_test1/project/Kconfig.tmp
```kconfig
source "D:/iotproject/LCHSP/OpenSiFli/githubsdk/SiFli-SDK/v2.5/SiFli-SDK-V2.5/customer/boards/sf32lb52-lchspi-ulp/hcpu/Kconfig.board"
source "$SIFLI_SDK/customer/boards/Kconfig.v2"
source "$SIFLI_SDK/Kconfig.v2"
orsource "sf-pkgs/Kconfig.conandeps"
rsource "Kconfig.proj"
```

## pan_test1/project/build_sf32lb52-lchspi-ulp_hcpu/Kconfig
```kconfig
source "$SIFLI_SDK/Kconfig.v2"
source "$SIFLI_SDK/customer/boards/Kconfig.v2"
source "D:/iotproject/LCHSP/OpenSiFli/githubsdk/SiFli-SDK/v2.5/SiFli-SDK-V2.5/customer/boards/sf32lb52-lchspi-ulp/hcpu/Kconfig.board"
osource "D:/iotproject/lcHspEc800m/lcHsp/lvgl/pan_test1/project/sf-pkgs/Kconfig.conandeps"
source "D:/iotproject/lcHspEc800m/lcHsp/lvgl/pan_test1/project/Kconfig.proj"
```

## pan_test1/project/build_sf32lb52-lchspi-ulp_hcpu/bootloader/Kconfig
```kconfig
source "$SIFLI_SDK/Kconfig.v2"
source "$SIFLI_SDK/customer/boards/Kconfig.v2"
source "D:/iotproject/LCHSP/OpenSiFli/githubsdk/SiFli-SDK/v2.5/SiFli-SDK-V2.5/customer/boards/sf32lb52-lchspi-ulp/hcpu/Kconfig.board"
osource "D:/iotproject/LCHSP/OpenSiFli/githubsdk/SiFli-SDK/v2.5/SiFli-SDK-V2.5/example/boot_loader/project/butterflmicro/ram_v2/sf-pkgs/Kconfig.conandeps"
source "D:/iotproject/LCHSP/OpenSiFli/githubsdk/SiFli-SDK/v2.5/SiFli-SDK-V2.5/example/boot_loader/project/butterflmicro/ram_v2/Kconfig.proj"
```

## pan_test1/project/build_sf32lb52-lchspi-ulp_hcpu/dfu/Kconfig
```kconfig
source "$SIFLI_SDK/Kconfig.v2"
source "$SIFLI_SDK/customer/boards/Kconfig.v2"
source "D:/iotproject/LCHSP/OpenSiFli/githubsdk/SiFli-SDK/v2.5/SiFli-SDK-V2.5/customer/boards/sf32lb52-lchspi-ulp/hcpu/Kconfig.board"
osource "D:/iotproject/LCHSP/OpenSiFli/githubsdk/SiFli-SDK/v2.5/SiFli-SDK-V2.5/example/dfu/project/sf-pkgs/Kconfig.conandeps"
source "D:/iotproject/LCHSP/OpenSiFli/githubsdk/SiFli-SDK/v2.5/SiFli-SDK-V2.5/example/dfu/project/Kconfig.proj"
```

## pan_test1/project/build_sf32lb52-lchspi-ulp_hcpu/lcpu/Kconfig
```kconfig
source "$SIFLI_SDK/Kconfig.v2"
source "$SIFLI_SDK/customer/boards/Kconfig.v2"
source "D:/iotproject/LCHSP/OpenSiFli/githubsdk/SiFli-SDK/v2.5/SiFli-SDK-V2.5/customer/boards/sf32lb52-lchspi-ulp/lcpu/Kconfig.board"
osource "D:/iotproject/LCHSP/OpenSiFli/githubsdk/SiFli-SDK/v2.5/SiFli-SDK-V2.5/example/ble/lcpu_general/project/common/sf-pkgs/Kconfig.conandeps"
source "D:/iotproject/LCHSP/OpenSiFli/githubsdk/SiFli-SDK/v2.5/SiFli-SDK-V2.5/example/ble/lcpu_general/project/common/Kconfig.proj"
```

## project/Kconfig.proj
```kconfig
#APP specific configuration.
config BF0_HCPU
    bool
    default y

config CUSTOM_MEM_MAP
    bool
    select custom_mem_map
    default y if !SOC_SIMULATOR

config ENABLE_DFU
    bool "enable dfu and add dfu sub-project"
    default n

config HSP_USING_OTA
    bool "enable HSP PAN OTA client"
    depends on BF0_HCPU
    default n
    help
        Enable version queries and handoff to the dedicated DFU PAN loader.

config HSP_OTA_SERVER_BASE_URL
    string "HSP OTA server base URL"
    depends on HSP_USING_OTA
    default ""
    help
        HTTPS base URL of the project OTA service. Keep empty until a trusted
        server containing firmware for this exact board is available.
```
